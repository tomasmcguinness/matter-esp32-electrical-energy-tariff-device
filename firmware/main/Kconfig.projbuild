## firmware/main/Kconfig.projbuild
```kconfig
menu "Electrical Energy Tariff Device"

    config TARIFF_TIMEZONE
        string "Local timezone (POSIX TZ)"
        default "GMT0BST,M3.5.0/1,M10.5.0"
        help
            Pushed schedules use local wall-clock times; this turns them into the UTC times
            the device works in. The default is UK time.

    config TARIFF_SNTP_SERVER
        string "SNTP server"
        default "pool.ntp.org"

    config MQTT_HOST
        string "MQTT host"
        default ""
        help
            Broker the cloud page publishes prices to: a hostname such as <cluster>.hivemq.cloud,
            or an IPv4 or IPv6 address. Leave empty to disable pushed prices.

    config MQTT_PORT
        int "MQTT port"
        range 1 65535
        default 8883

    config MQTT_USE_TLS
        bool "Connect over TLS"
        default y
        help
            Verifies the broker against the built-in certificate bundle. Turn off for a local
            broker on plain MQTT (usually port 1883).

    config MQTT_USERNAME
        string "MQTT username"
        default ""

    config MQTT_PASSWORD
        string "MQTT password"
        default ""

    config MQTT_TOPIC_PREFIX
        string "MQTT topic prefix"
        default "electrical-energy-tariff"
        help
            The device subscribes to <prefix>/<device id>/schedule.

endmenu
```

## firmware/sdkconfig.defaults
```kconfig
CONFIG_IDF_TARGET="esp32c6"
CONFIG_ESPTOOLPY_FLASHSIZE_8MB=y

#enable BT
CONFIG_BT_ENABLED=y
CONFIG_BT_NIMBLE_ENABLED=y
CONFIG_BT_NIMBLE_EXT_ADV=n
CONFIG_USE_BLE_ONLY_FOR_COMMISSIONING=y

#enable lwip ipv6 autoconfig
CONFIG_LWIP_IPV6_AUTOCONFIG=n

# Use a custom partition table
CONFIG_PARTITION_TABLE_CUSTOM=y
CONFIG_PARTITION_TABLE_FILENAME="partitions.csv"
CONFIG_PARTITION_TABLE_OFFSET=0xC000

# Only uses 2 dynamic endpoints
CONFIG_ESP_MATTER_MAX_DYNAMIC_ENDPOINT_COUNT=2

#enable lwIP route hooks
CONFIG_LWIP_HOOK_IP6_ROUTE_DEFAULT=y
CONFIG_LWIP_HOOK_ND6_GET_GW_DEFAULT=y

# Button
CONFIG_BUTTON_PERIOD_TIME_MS=20
CONFIG_BUTTON_LONG_PRESS_TIME_MS=5000

#
CONFIG_ENABLE_WIFI_STATION=y
CONFIG_ENABLE_WIFI_AP=n

# Enable OTA Requestor
CONFIG_ENABLE_OTA_REQUESTOR=y

# Enable HKDF in mbedtls
CONFIG_MBEDTLS_HKDF_C=y

# Buttons
CONFIG_BSP_BUTTONS_NUM=1
```
